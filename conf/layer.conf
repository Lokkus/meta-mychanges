## conf/layer.conf
```bitbake
# We have a conf and classes directory, add to BBPATH
BBPATH .= ":${LAYERDIR}"

# We have recipes-* directories, add to BBFILES
BBFILES += "${LAYERDIR}/recipes-*/*/*.bb \
            ${LAYERDIR}/recipes-*/*/*.bbappend"

BBFILE_COLLECTIONS += "meta-mychanges"
BBFILE_PATTERN_meta-mychanges = "^${LAYERDIR}/"
BBFILE_PRIORITY_meta-mychanges = "99"


LAYERDEPENDS_meta-mychanges = "core"
LAYERSERIES_COMPAT_meta-mychanges = "nanbield"
```
